/*
  AGAP - Arduino Guitar Auto Player
  Target board: Arduino Mega 2560

  - 18 solenoids (6 strings x frets 1-3) press the strings, driven with
    Kick-and-Hold PWM generated by a Timer2 interrupt (no extra PWM chip).
  - 6 servos (one pick per string) pluck / strum the real guitar.
  - On-board constraint-satisfaction chord search: any chord name is turned
    into the lowest-cost voicing that only uses frets 0-3 (barre -> open).
  - ASSIST mode: one button / screen tap / phone tap = one strum.
  - TEACH mode : slow, repeated finger placement -> arpeggio -> strums.

  Command ports (same newline-terminated text protocol on all three):
    Serial  USB          115200  PC app / Serial Monitor
    Serial1 D19/D18      9600    HC-05 Bluetooth (phone app)
    Serial2 D17/D16      9600    Nextion touch screen (buttons send e.g. "NEXT\n")

  ------------------------------ Pin map ------------------------------
  Solenoids - through a logic-level MOSFET + flyback diode, never directly!
    sol = string*3 + (fret-1); string 0 = low E (6th) ... 5 = high e (1st)
      string  6th E : fret1 D22  fret2 D23  fret3 D24
      string  5th A : fret1 D25  fret2 D26  fret3 D27
      string  4th D : fret1 D28  fret2 D29  fret3 D37
      string  3rd G : fret1 D36  fret2 D35  fret3 D34
      string  2nd B : fret1 D33  fret2 D32  fret3 D31
      string  1st e : fret1 D30  fret2 D49  fret3 D48
    (sol 0-7 = PORTA, 8-15 = PORTC, 16-17 = PORTL bit0-1)
  Servos (pick per string, 6th..1st): D2 D3 D4 D5 D6 D7
  Buttons (to GND, internal pull-up): A0 STRUM  A1 NEXT  A2 PREV  A3 MODE  A4 STOP
  Optional tempo potentiometer: A8 (set USE_TEMPO_POT to 1)
*/

#include <Servo.h>
#include <util/atomic.h>
#include <string.h>
#include <stdlib.h>
#include <ctype.h>

// ============================ Configuration ============================
#define USE_TEMPO_POT 0

const uint8_t NUM_STRINGS = 6;
const uint8_t NUM_FRETS   = 3;
const uint8_t NUM_SOL     = NUM_STRINGS * NUM_FRETS;
const int8_t  MUTED       = -1;

uint16_t kickMs   = 40;   // full-power pulse that seats the plunger
uint8_t  holdDuty = 77;   // 0..255 hold power (~30 %) - keeps coils cool
const uint32_t MAX_HOLD_MS  = 10000; // safety: release a forgotten chord
const uint8_t  STAGGER_MS   = 4;     // spread kicks to limit inrush current
const uint8_t  SETTLE_MS    = 10;    // extra wait after the last kick before plucking
const uint8_t  STRUM_GAP_MS = 18;    // delay between strings in a strum

const uint8_t SERVO_PIN[NUM_STRINGS] = {2, 3, 4, 5, 6, 7};
uint8_t pickA[NUM_STRINGS] = {70, 70, 70, 70, 70, 70};     // calibrate per string:
uint8_t pickB[NUM_STRINGS] = {110, 110, 110, 110, 110, 110}; // A/B sit either side of it

enum { BTN_STRUM, BTN_NEXT, BTN_PREV, BTN_MODE, BTN_STOP, NUM_BTN };
const uint8_t BTN_PIN[NUM_BTN] = {A0, A1, A2, A3, A4};
const uint8_t TEMPO_POT_PIN = A8;

const uint8_t OPEN_PC[NUM_STRINGS] = {4, 9, 2, 7, 11, 4};  // standard tuning E A D G B E

Stream* console = &Serial;  // replies go to the port that sent the last command

// Forward declarations: the Arduino builder collects a prototype for every
// function in this file and inserts them all before the FIRST function
// below (rebuildMasks) - earlier than where these types are actually
// defined further down. Without this, those prototypes fail to compile.
struct Voicing;
struct Quality;
enum Mode : uint8_t;

// ================= Solenoid driver (Kick-and-Hold PWM) =================
// Timer2 overflow  -> every active coil HIGH (start of the ~7.8 kHz period)
// Timer2 compare A -> only KICK coils stay HIGH, HOLD coils drop out
// => KICK coils get 100 %, HOLD coils get holdDuty/256.
volatile uint8_t onA, onC, onL, kickA, kickC, kickL;

ISR(TIMER2_OVF_vect)   { PORTA = onA;   PORTC = onC;   PORTL = (PORTL & 0xFC) | onL;   }
ISR(TIMER2_COMPA_vect) { PORTA = kickA; PORTC = kickC; PORTL = (PORTL & 0xFC) | kickL; }

enum SolState : uint8_t { SOL_OFF, SOL_PENDING, SOL_KICK, SOL_HOLD };
SolState solState[NUM_SOL];
uint32_t solTime[NUM_SOL];  // PENDING: start time, KICK/HOLD: time of kick
bool     masksDirty = false;

inline uint8_t solIndex(uint8_t s, uint8_t fret) { return s * NUM_FRETS + (fret - 1); }

static inline void setBit(uint8_t i, uint8_t& a, uint8_t& c, uint8_t& l) {
  if (i < 8) a |= _BV(i); else if (i < 16) c |= _BV(i - 8); else l |= _BV(i - 16);
}

void rebuildMasks() {
  uint8_t a = 0, c = 0, l = 0, ka = 0, kc = 0, kl = 0;
  for (uint8_t i = 0; i < NUM_SOL; i++) {
    if (solState[i] == SOL_KICK) { setBit(i, a, c, l); setBit(i, ka, kc, kl); }
    else if (solState[i] == SOL_HOLD) setBit(i, a, c, l);
  }
  ATOMIC_BLOCK(ATOMIC_RESTORESTATE) { onA = a; onC = c; onL = l; kickA = ka; kickC = kc; kickL = kl; }
  masksDirty = false;
}

void solenoidsBegin() {
  DDRA = 0xFF; DDRC = 0xFF; DDRL |= 0x03;
  PORTA = 0;   PORTC = 0;   PORTL &= 0xFC;
  TCCR2A = 0;              // normal mode, OC2A/OC2B pins disconnected
  TCCR2B = _BV(CS21);      // clk/8 -> 16 MHz / 8 / 256 = 7.8 kHz
  OCR2A  = holdDuty;
  TIMSK2 = _BV(TOIE2) | _BV(OCIE2A);
}

// Returns true if the coil was off and will now be kicked.
bool pressSolenoid(uint8_t i, uint32_t startAt) {
  if (solState[i] == SOL_OFF) { solState[i] = SOL_PENDING; solTime[i] = startAt; return true; }
  if (solState[i] == SOL_HOLD) solTime[i] = millis() - kickMs;  // refresh safety timer
  return false;
}

void releaseSolenoid(uint8_t i) {
  if (solState[i] != SOL_OFF) { solState[i] = SOL_OFF; masksDirty = true; }
}

void releaseAll() {
  for (uint8_t i = 0; i < NUM_SOL; i++) releaseSolenoid(i);
  rebuildMasks();
}

void updateSolenoids(uint32_t now) {
  for (uint8_t i = 0; i < NUM_SOL; i++) {
    switch (solState[i]) {
      case SOL_PENDING:
        if ((int32_t)(now - solTime[i]) >= 0) { solState[i] = SOL_KICK; solTime[i] = now; masksDirty = true; }
        break;
      case SOL_KICK:
        if (now - solTime[i] >= kickMs) { solState[i] = SOL_HOLD; masksDirty = true; }
        break;
      case SOL_HOLD:
        if (now - solTime[i] >= MAX_HOLD_MS) { solState[i] = SOL_OFF; masksDirty = true; }
        break;
      default: break;
    }
  }
  if (masksDirty) rebuildMasks();
}

// ============================== Voicings ==============================
struct Voicing { int8_t fret[NUM_STRINGS]; int16_t cost; };  // fret: -1 muted, 0 open, 1-3

// Presses exactly the frets of v; returns ms until every coil is seated.
uint16_t applyVoicing(const Voicing& v) {
  uint32_t t = millis();
  uint8_t kicked = 0;
  for (uint8_t s = 0; s < NUM_STRINGS; s++)
    for (uint8_t f = 1; f <= NUM_FRETS; f++) {
      uint8_t i = solIndex(s, f);
      if (v.fret[s] == f) { if (pressSolenoid(i, t + STAGGER_MS * kicked)) kicked++; }
      else releaseSolenoid(i);
    }
  rebuildMasks();
  return kicked ? STAGGER_MS * (kicked - 1) + kickMs + SETTLE_MS : 0;
}

// =============================== Strummer ===============================
Servo picks[NUM_STRINGS];
bool  pickAtB[NUM_STRINGS];

// Each pluck swings the pick across the string to the other side.
void pluck(uint8_t s) {
  pickAtB[s] = !pickAtB[s];
  picks[s].write(pickAtB[s] ? pickB[s] : pickA[s]);
}

struct {
  uint8_t  mask;   // strings to sound
  bool     down;   // true: 6th -> 1st
  uint8_t  idx;
  uint8_t  gap;
  uint32_t nextAt;
  bool     active;
} strum;

void startStrum(const Voicing& v, bool down, uint32_t startAt, uint8_t gap = STRUM_GAP_MS) {
  strum.mask = 0;
  for (uint8_t s = 0; s < NUM_STRINGS; s++) if (v.fret[s] != MUTED) strum.mask |= _BV(s);
  strum.down = down; strum.idx = 0; strum.gap = gap; strum.nextAt = startAt;
  strum.active = strum.mask != 0;
}

void updateStrum(uint32_t now) {
  if (!strum.active || (int32_t)(now - strum.nextAt) < 0) return;
  while (strum.idx < NUM_STRINGS) {
    uint8_t s = strum.down ? strum.idx : NUM_STRINGS - 1 - strum.idx;
    strum.idx++;
    if (strum.mask & _BV(s)) { pluck(s); strum.nextAt = now + strum.gap; return; }
  }
  strum.active = false;
}

// ============== AI chord search (constraint satisfaction) ==============
// Constraint : every sounded note must be a chord tone, frets limited to 0-3.
// Cost       : missing chord tones (weighted by importance), muted strings,
//              holes between sounded strings, bass not on the root, presses.
// Depth-first search with branch-and-bound over 6 strings x {x,0,1,2,3}.
struct Quality { const char* name; uint8_t n; uint8_t iv[4]; uint8_t w[4]; };
const Quality QUALITIES[] = {
  {"",     3, {0, 4, 7},     {40, 40, 8}},
  {"maj",  3, {0, 4, 7},     {40, 40, 8}},
  {"m",    3, {0, 3, 7},     {40, 40, 8}},
  {"min",  3, {0, 3, 7},     {40, 40, 8}},
  {"7",    4, {0, 4, 7, 10}, {40, 40, 6, 25}},
  {"maj7", 4, {0, 4, 7, 11}, {40, 40, 6, 25}},
  {"M7",   4, {0, 4, 7, 11}, {40, 40, 6, 25}},
  {"m7",   4, {0, 3, 7, 10}, {40, 40, 6, 25}},
  {"6",    4, {0, 4, 7, 9},  {40, 40, 6, 25}},
  {"m6",   4, {0, 3, 7, 9},  {40, 40, 6, 25}},
  {"add9", 4, {0, 4, 7, 2},  {40, 40, 6, 25}},
  {"sus2", 3, {0, 2, 7},     {40, 40, 8}},
  {"sus4", 3, {0, 5, 7},     {40, 40, 8}},
  {"sus",  3, {0, 5, 7},     {40, 40, 8}},
  {"dim",  3, {0, 3, 6},     {40, 40, 30}},
  {"aug",  3, {0, 4, 8},     {40, 40, 30}},
  {"5",    2, {0, 7},        {40, 40}},
};

const int16_t COST_MUTE          = 6;
const int16_t COST_INNER_MUTE    = 4;
const int16_t COST_FRETTED       = 1;
const int16_t COST_BASS_NOT_ROOT = 15;
const int16_t COST_THIN          = 60;  // per string below 3 sounded strings

struct {
  uint8_t root;
  const Quality* q;
  int8_t cur[NUM_STRINGS];
  Voicing best;
} srch;

bool parseChord(const char* txt, uint8_t& root, const Quality*& q) {
  static const uint8_t LETTER_PC[7] = {9, 11, 0, 2, 4, 5, 7};  // A..G
  char L = toupper(txt[0]);
  if (L < 'A' || L > 'G') return false;
  int8_t pc = LETTER_PC[L - 'A'];
  const char* p = txt + 1;
  if (*p == '#') { pc++; p++; } else if (*p == 'b') { pc--; p++; }
  root = (pc + 12) % 12;
  for (const Quality& cand : QUALITIES)
    if (strcmp(p, cand.name) == 0) { q = &cand; return true; }
  return false;
}

int8_t toneIndex(uint8_t pc) {
  uint8_t iv = (pc + 12 - srch.root) % 12;
  for (uint8_t k = 0; k < srch.q->n; k++) if (srch.q->iv[k] == iv) return k;
  return -1;
}

int16_t finalCost(uint8_t covered) {
  int16_t c = 0;
  for (uint8_t k = 0; k < srch.q->n; k++) if (!(covered & _BV(k))) c += srch.q->w[k];
  int8_t first = -1, last = -1;
  uint8_t sounded = 0;
  for (uint8_t s = 0; s < NUM_STRINGS; s++)
    if (srch.cur[s] != MUTED) { if (first < 0) first = s; last = s; sounded++; }
  if (sounded < 3) c += COST_THIN * (3 - sounded);
  if (first >= 0) {
    if ((OPEN_PC[first] + srch.cur[first]) % 12 != srch.root) c += COST_BASS_NOT_ROOT;
    for (int8_t s = first + 1; s < last; s++) if (srch.cur[s] == MUTED) c += COST_INNER_MUTE;
  }
  return c;
}

void dfs(uint8_t s, uint8_t covered, int16_t partial) {
  if (partial >= srch.best.cost) return;  // bound
  if (s == NUM_STRINGS) {
    int16_t c = partial + finalCost(covered);
    if (c < srch.best.cost) { memcpy(srch.best.fret, srch.cur, NUM_STRINGS); srch.best.cost = c; }
    return;
  }
  for (int8_t f = 0; f <= NUM_FRETS; f++) {
    int8_t k = toneIndex((OPEN_PC[s] + f) % 12);
    if (k < 0) continue;  // constraint: chord tones only
    srch.cur[s] = f;
    dfs(s + 1, covered | _BV(k), partial + (f ? COST_FRETTED : 0));
  }
  srch.cur[s] = MUTED;
  dfs(s + 1, covered, partial + COST_MUTE);
}

bool solveChord(const char* name, Voicing& out) {
  if (!parseChord(name, srch.root, srch.q)) return false;
  srch.best.cost = INT16_MAX;
  dfs(0, 0, 0);
  out = srch.best;
  return true;
}

void printVoicing(Stream& o, const char* name, const Voicing& v) {
  o.print(name);
  o.print(F(" -> "));
  for (uint8_t s = 0; s < NUM_STRINGS; s++) {
    if (v.fret[s] == MUTED) o.print('x'); else o.print(v.fret[s]);
    o.print(' ');
  }
  o.print(F(" (cost "));
  o.print(v.cost);
  o.println(')');
}

// ============================ Progression ============================
const uint8_t MAX_PROG = 16;
struct Step { char name[8]; Voicing v; };
Step    prog[MAX_PROG];
uint8_t progLen = 0, progPos = 0;

// ================================ Modes ================================
enum Mode : uint8_t { MODE_ASSIST, MODE_TEACH };
Mode     mode = MODE_ASSIST;
uint16_t bpm = 40;          // teaching tempo
bool     strumDown = true;  // assist mode alternates down / up strokes

enum TeachStep : uint8_t { T_RELEASE, T_PLACE, T_ARPEGGIO, T_STRUM, T_NEXT };
const uint8_t TEACH_STRUMS = 4;
struct { TeachStep step; uint8_t idx, rep; uint32_t nextAt; bool running; } teach;

void playVoicing(const Voicing& v, bool down) {
  uint16_t settle = applyVoicing(v);
  startStrum(v, down, millis() + settle);
}

void selectChord(uint8_t pos) {
  if (progLen == 0) return;
  progPos = pos;
  if (mode == MODE_TEACH) { teach.step = T_RELEASE; teach.nextAt = millis(); return; }
  applyVoicing(prog[progPos].v);  // pre-press so the player sees the shape
  printVoicing(*console, prog[progPos].name, prog[progPos].v);
}

void assistStrum() {
  if (progLen == 0) return;
  playVoicing(prog[progPos].v, strumDown);
  strumDown = !strumDown;
}

void stopAll() {
  teach.running = false;
  strum.active = false;
  releaseAll();
}

void setMode(Mode m) {
  stopAll();
  mode = m;
  if (m == MODE_TEACH) { teach.running = true; teach.step = T_RELEASE; teach.nextAt = millis(); }
  console->println(m == MODE_TEACH ? F("MODE TEACH") : F("MODE ASSIST"));
}

void updateTeach(uint32_t now) {
  if (!teach.running || progLen == 0 || (int32_t)(now - teach.nextAt) < 0) return;
  const uint32_t beat = 60000UL / bpm;
  const Step& st = prog[progPos];
  switch (teach.step) {
    case T_RELEASE:
      releaseAll();
      console->print(F("TEACH "));
      printVoicing(*console, st.name, st.v);
      teach.idx = 0;
      teach.step = T_PLACE;
      teach.nextAt = now + beat / 2;
      break;
    case T_PLACE:  // place one finger per beat, low string first
      while (teach.idx < NUM_STRINGS && st.v.fret[teach.idx] <= 0) teach.idx++;
      if (teach.idx < NUM_STRINGS) {
        uint8_t s = teach.idx++;
        pressSolenoid(solIndex(s, st.v.fret[s]), now);
        console->print(F("  finger: string "));
        console->print(NUM_STRINGS - s);
        console->print(F(" fret "));
        console->println(st.v.fret[s]);
        teach.nextAt = now + beat;
      } else {
        teach.idx = 0;
        teach.step = T_ARPEGGIO;
        teach.nextAt = now + beat / 2;
      }
      break;
    case T_ARPEGGIO:  // let every string ring on its own
      while (teach.idx < NUM_STRINGS && st.v.fret[teach.idx] == MUTED) teach.idx++;
      if (teach.idx < NUM_STRINGS) {
        pluck(teach.idx++);
        teach.nextAt = now + beat / 2;
      } else {
        teach.rep = 0;
        teach.step = T_STRUM;
        teach.nextAt = now + beat;
      }
      break;
    case T_STRUM:
      startStrum(st.v, true, now, STRUM_GAP_MS * 2);
      teach.nextAt = now + beat;
      if (++teach.rep >= TEACH_STRUMS) teach.step = T_NEXT;
      break;
    case T_NEXT:
      progPos = (progPos + 1) % progLen;
      teach.step = T_RELEASE;
      teach.nextAt = now + beat / 2;
      break;
  }
}

// =============================== Buttons ===============================
bool     btnStable[NUM_BTN], btnRaw[NUM_BTN];
uint32_t btnT[NUM_BTN];

bool btnPressed(uint8_t b, uint32_t now) {
  bool r = digitalRead(BTN_PIN[b]) == LOW;
  if (r != btnRaw[b]) { btnRaw[b] = r; btnT[b] = now; }
  if (now - btnT[b] > 25 && r != btnStable[b]) { btnStable[b] = r; return r; }
  return false;
}

void pollButtons(uint32_t now) {
  if (btnPressed(BTN_STRUM, now)) {
    if (mode == MODE_ASSIST) assistStrum();
    else { teach.running = !teach.running; teach.nextAt = now; }  // pause / resume lesson
  }
  if (btnPressed(BTN_NEXT, now) && progLen) selectChord((progPos + 1) % progLen);
  if (btnPressed(BTN_PREV, now) && progLen) selectChord((progPos + progLen - 1) % progLen);
  if (btnPressed(BTN_MODE, now)) setMode(mode == MODE_ASSIST ? MODE_TEACH : MODE_ASSIST);
  if (btnPressed(BTN_STOP, now)) stopAll();
}

// =========================== Command protocol ===========================
bool eq(const char* a, const char* b) { return strcasecmp(a, b) == 0; }

void printHelp(Stream& o) {
  o.println(F("SHOW <chord>        AI voicing only (no hardware)"));
  o.println(F("CHORD <chord>       press + strum, e.g. CHORD F#m7"));
  o.println(F("RAW x 3 2 0 1 0     press + strum explicit frets (6th..1st)"));
  o.println(F("PROG C G Am F       load progression (max 16)"));
  o.println(F("MODE ASSIST|TEACH   NEXT  PREV  STRUM [D|U]  STOP  STATUS"));
  o.println(F("TEMPO <bpm>  HOLD <percent>  KICK <ms>  PLUCK <string 1-6>"));
}

void handleCommand(char* line, Stream& out) {
  console = &out;
  char* cmd = strtok(line, " \t");
  if (!cmd) return;

  if (eq(cmd, "HELP")) {
    printHelp(out);
  } else if (eq(cmd, "SHOW") || eq(cmd, "CHORD")) {
    char* name = strtok(NULL, " \t");
    Voicing v;
    if (!name || !solveChord(name, v)) { out.println(F("ERR unknown chord")); return; }
    printVoicing(out, name, v);
    if (eq(cmd, "CHORD")) { teach.running = false; playVoicing(v, true); }
  } else if (eq(cmd, "RAW")) {
    Voicing v;
    v.cost = 0;
    for (uint8_t s = 0; s < NUM_STRINGS; s++) {
      char* tok = strtok(NULL, " \t");
      if (!tok) { out.println(F("ERR need 6 frets")); return; }
      int f = (tok[0] == 'x' || tok[0] == 'X') ? MUTED : atoi(tok);
      if (f < MUTED || f > NUM_FRETS) { out.println(F("ERR fret must be x,0-3")); return; }
      v.fret[s] = f;
    }
    teach.running = false;
    playVoicing(v, true);
    printVoicing(out, "RAW", v);
  } else if (eq(cmd, "PROG")) {
    Step tmp[MAX_PROG];
    uint8_t n = 0;
    for (char* tok = strtok(NULL, " \t"); tok && n < MAX_PROG; tok = strtok(NULL, " \t")) {
      if (strlen(tok) >= sizeof(tmp[n].name) || !solveChord(tok, tmp[n].v)) {
        out.print(F("ERR unknown chord "));
        out.println(tok);
        return;
      }
      strcpy(tmp[n].name, tok);
      printVoicing(out, tmp[n].name, tmp[n].v);
      n++;
    }
    if (n == 0) { out.println(F("ERR empty progression")); return; }
    memcpy(prog, tmp, sizeof(Step) * n);
    progLen = n;
    progPos = 0;
    if (mode == MODE_TEACH) { teach.step = T_RELEASE; teach.nextAt = millis(); }
  } else if (eq(cmd, "MODE")) {
    char* m = strtok(NULL, " \t");
    if (m && eq(m, "TEACH")) setMode(MODE_TEACH);
    else if (m && eq(m, "ASSIST")) setMode(MODE_ASSIST);
    else out.println(F("ERR MODE ASSIST|TEACH"));
  } else if (eq(cmd, "NEXT")) {
    if (progLen) selectChord((progPos + 1) % progLen);
  } else if (eq(cmd, "PREV")) {
    if (progLen) selectChord((progPos + progLen - 1) % progLen);
  } else if (eq(cmd, "STRUM")) {
    char* d = strtok(NULL, " \t");
    if (d) strumDown = !(d[0] == 'U' || d[0] == 'u');
    assistStrum();
  } else if (eq(cmd, "TEMPO")) {
    char* a = strtok(NULL, " \t");
    bpm = constrain(a ? atoi(a) : bpm, 20, 200);
    out.print(F("TEMPO "));
    out.println(bpm);
  } else if (eq(cmd, "HOLD")) {
    char* a = strtok(NULL, " \t");
    holdDuty = (uint16_t)constrain(a ? atoi(a) : 30, 10, 100) * 255 / 100;
    OCR2A = holdDuty;
    out.print(F("HOLD duty "));
    out.println(holdDuty);
  } else if (eq(cmd, "KICK")) {
    char* a = strtok(NULL, " \t");
    kickMs = constrain(a ? atoi(a) : kickMs, 10, 200);
    out.print(F("KICK ms "));
    out.println(kickMs);
  } else if (eq(cmd, "PLUCK")) {  // servo calibration helper
    char* a = strtok(NULL, " \t");
    int n = a ? atoi(a) : 0;
    if (n >= 1 && n <= NUM_STRINGS) pluck(NUM_STRINGS - n);
    else out.println(F("ERR PLUCK 1-6"));
  } else if (eq(cmd, "STOP")) {
    stopAll();
    out.println(F("STOPPED"));
  } else if (eq(cmd, "STATUS")) {
    out.print(mode == MODE_TEACH ? F("TEACH") : F("ASSIST"));
    out.print(F(" bpm="));
    out.print(bpm);
    out.print(F(" chord "));
    out.print(progPos + 1);
    out.print('/');
    out.println(progLen);
    if (progLen) printVoicing(out, prog[progPos].name, prog[progPos].v);
  } else {
    out.println(F("ERR unknown command, type HELP"));
  }
}

struct LineBuf { char buf[96]; uint8_t len; };
LineBuf lineBuf[3];
Stream* const cmdPorts[3] = {&Serial, &Serial1, &Serial2};

void pollPorts() {
  for (uint8_t p = 0; p < 3; p++) {
    LineBuf& lb = lineBuf[p];
    while (cmdPorts[p]->available()) {
      char c = cmdPorts[p]->read();
      if (c == '\r' || (uint8_t)c >= 0x80) continue;  // ignore CR and Nextion 0xFF terminators
      if (c == '\n') {
        lb.buf[lb.len] = '\0';
        if (lb.len) handleCommand(lb.buf, *cmdPorts[p]);
        lb.len = 0;
      } else if (lb.len < sizeof(lb.buf) - 1) {
        lb.buf[lb.len++] = c;
      }
    }
  }
}

// ============================== Main ==============================
void setup() {
  Serial.begin(115200);
  Serial1.begin(9600);
  Serial2.begin(9600);

  solenoidsBegin();
  for (uint8_t s = 0; s < NUM_STRINGS; s++) {
    picks[s].attach(SERVO_PIN[s]);  // <= 12 servos on Mega use Timer5 only
    picks[s].write(pickA[s]);
  }
  for (uint8_t b = 0; b < NUM_BTN; b++) pinMode(BTN_PIN[b], INPUT_PULLUP);

  char demo[] = "PROG C G Am F";
  handleCommand(demo, Serial);
  Serial.println(F("AGAP ready - type HELP"));
}

void loop() {
  uint32_t now = millis();
  pollPorts();
  pollButtons(now);
#if USE_TEMPO_POT
  static uint32_t potAt;
  if (mode == MODE_TEACH && now - potAt > 200) {
    potAt = now;
    bpm = map(analogRead(TEMPO_POT_PIN), 0, 1023, 20, 120);
  }
#endif
  updateTeach(now);
  updateStrum(now);
  updateSolenoids(now);
}
